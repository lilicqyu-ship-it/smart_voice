/*
 * smart_voice - LVGL UI: status panel, waveform, chat bubbles
 *
 * Screen layout (800x480):
 *  +--------------------------------------------------------------+
 *  | 智能语音助手                                        WiFi状态  |  56 px
 *  +--------------------------------------------------------------+
 *  |   [waveform bars]        状态文字 (等待唤醒/聆听中/思考中...)  | 120 px
 *  +--------------------------------------------------------------+
 *  |  对话气泡滚动区 (user right/blue, assistant left/gray)         |  rest
 *  |                                                              |
 *  +--------------------------------------------------------------+
 *
 * SPDX-License-Identifier: MIT
 */
#include "app_ui.h"

#include <string.h>
#include <math.h>
#include "esp_log.h"
#include "esp_timer.h"
#include "esp_heap_caps.h"
#include "bsp/esp-bsp.h"
#include "lvgl.h"

#include "app_priv.h"
#include "app_afe.h"
#include "board_audio.h"
#include "font_cjk_20.h"

static const char *TAG = "ui";

/* Full-coverage CJK font generated by tools/gen_font.sh (GB2312 + ASCII). */
#define FONT_CJK    (&font_cjk_20)

#define COL_BG      lv_color_hex(0x101418)
#define COL_PANEL   lv_color_hex(0x1A1F26)
#define COL_ACCENT  lv_color_hex(0x3B82F6)
#define COL_USER    lv_color_hex(0x2B6CB0)
#define COL_BOT     lv_color_hex(0x272D36)
#define COL_TEXT    lv_color_hex(0xE8EAED)
#define COL_DIM     lv_color_hex(0x8A919C)
#define COL_GREEN   lv_color_hex(0x22C55E)

static lv_obj_t *s_screen;
static lv_obj_t *s_state_label;
static lv_obj_t *s_state_dot;
static lv_obj_t *s_wifi_label;
static lv_obj_t *s_volume_label;
static lv_obj_t *s_volume_slider;
static lv_obj_t *s_chat_list;
static lv_obj_t *s_bars[8];
static lv_obj_t *s_stream_label;      /* current streaming assistant bubble */
static char *s_stream_text;           /* PSRAM accumulator */
static size_t s_stream_len;
static int64_t s_last_stream_update;
static lv_timer_t *s_bar_timer;
static int s_bar_frame;

#define UI_TOP_H       56
#define UI_STATUS_H    148
#define UI_MAX_CHAT_ROWS 24

static const char *state_text(app_state_t st)
{
    switch (st) {
    case APP_STATE_IDLE:      return "说「你好,小鱼」开始对话";
    case APP_STATE_LISTENING: return "聆听中…";
    case APP_STATE_THINKING:  return "思考中…";
    case APP_STATE_SPEAKING:  return "说话中（点按屏幕可打断）";
    case APP_STATE_ERROR:     return "出错了，请查看日志";
    default:                  return "启动中…";
    }
}

static lv_obj_t *add_bubble(const char *text, bool user)
{
    /* Keep the display responsive over long-running conversations.  The
     * model history is bounded separately; old visual bubbles should not
     * consume LVGL heap forever. */
    while (lv_obj_get_child_count(s_chat_list) >= UI_MAX_CHAT_ROWS) {
        lv_obj_delete(lv_obj_get_child(s_chat_list, 0));
    }

    lv_obj_t *row = lv_obj_create(s_chat_list);
    lv_obj_set_size(row, LV_PCT(100), LV_SIZE_CONTENT);
    lv_obj_set_style_bg_opa(row, LV_OPA_TRANSP, 0);
    lv_obj_set_style_border_width(row, 0, 0);
    lv_obj_set_style_pad_all(row, 4, 0);
    lv_obj_clear_flag(row, LV_OBJ_FLAG_SCROLLABLE);

    lv_obj_t *bubble = lv_obj_create(row);
    lv_obj_set_size(bubble, LV_PCT(72), LV_SIZE_CONTENT);
    lv_obj_align(bubble, user ? LV_ALIGN_TOP_RIGHT : LV_ALIGN_TOP_LEFT, 0, 0);
    lv_obj_set_style_bg_color(bubble, user ? COL_USER : COL_BOT, 0);
    lv_obj_set_style_bg_opa(bubble, LV_OPA_COVER, 0);
    lv_obj_set_style_border_width(bubble, 0, 0);
    lv_obj_set_style_radius(bubble, 12, 0);
    lv_obj_set_style_pad_all(bubble, 10, 0);
    lv_obj_clear_flag(bubble, LV_OBJ_FLAG_SCROLLABLE);

    lv_obj_t *label = lv_label_create(bubble);
    lv_obj_set_width(label, LV_PCT(100));
    lv_label_set_long_mode(label, LV_LABEL_LONG_WRAP);
    lv_obj_set_style_text_font(label, FONT_CJK, 0);
    lv_obj_set_style_text_color(label, COL_TEXT, 0);
    lv_label_set_text(label, text);

    lv_obj_scroll_to_view(row, LV_ANIM_OFF);
    lv_obj_scroll_to_y(s_chat_list, LV_COORD_MAX, LV_ANIM_OFF);
    return label;
}

/* ---------------------------------------------------------------- */

void app_ui_user_msg(const char *text)
{
    if (!lvgl_port_lock(3000)) return;
    add_bubble(text, true);
    lvgl_port_unlock();
}

void app_ui_assistant_begin(void)
{
    if (!lvgl_port_lock(3000)) return;
    s_stream_len = 0;
    if (s_stream_text) s_stream_text[0] = 0;
    s_last_stream_update = 0;
    s_stream_label = add_bubble("…", false);
    lvgl_port_unlock();
}

void app_ui_assistant_append(const char *text)
{
    if (!s_stream_text) return;
    size_t len = strlen(text);
    if (s_stream_len + len >= 15000) return;
    memcpy(s_stream_text + s_stream_len, text, len);
    s_stream_len += len;
    s_stream_text[s_stream_len] = 0;

    int64_t now = esp_timer_get_time() / 1000;
    if (now - s_last_stream_update < 120) return;   /* throttle redraws */
    s_last_stream_update = now;

    if (!lvgl_port_lock(3000)) return;
    if (s_stream_label) lv_label_set_text(s_stream_label, s_stream_text);
    lv_obj_scroll_to_y(s_chat_list, LV_COORD_MAX, LV_ANIM_OFF);
    lvgl_port_unlock();
}

void app_ui_assistant_end(void)
{
    if (!lvgl_port_lock(3000)) return;
    if (s_stream_label) {
        if (s_stream_text && s_stream_len > 0) {
            lv_label_set_text(s_stream_label, s_stream_text);
        }
        lv_obj_scroll_to_y(s_chat_list, LV_COORD_MAX, LV_ANIM_OFF);
    }
    s_stream_label = NULL;
    lvgl_port_unlock();
}

void app_ui_clear_chat(void)
{
    if (!lvgl_port_lock(3000)) return;
    lv_obj_clean(s_chat_list);
    s_stream_label = NULL;
    s_stream_len = 0;
    if (s_stream_text) s_stream_text[0] = 0;
    lvgl_port_unlock();
}

void app_ui_set_wifi(bool connected, const char *ip)
{
    if (!lvgl_port_lock(3000)) return;
    if (connected) {
        lv_obj_set_style_text_color(s_wifi_label, COL_GREEN, 0);
        lv_label_set_text_fmt(s_wifi_label, "WiFi %s", ip ? ip : "");
    } else {
        lv_obj_set_style_text_color(s_wifi_label, COL_DIM, 0);
        lv_label_set_text(s_wifi_label, "WiFi 未连接");
    }
    lvgl_port_unlock();
}

static void update_volume_label(int volume)
{
    if (s_volume_label) {
        lv_label_set_text_fmt(s_volume_label, "%d%%", volume);
    }
}

static void volume_slider_cb(lv_event_t *e)
{
    lv_event_stop_bubbling(e);
    if (lv_event_get_code(e) != LV_EVENT_VALUE_CHANGED) {
        return;
    }

    int volume = (int)lv_slider_get_value(lv_event_get_target(e));
    esp_err_t err = board_audio_set_volume(volume);
    if (err != ESP_OK) {
        ESP_LOGW(TAG, "set volume %d failed: %s", volume, esp_err_to_name(err));
    }
    update_volume_label(volume);
}

/* animated equalizer bars */
static void bar_timer_cb(lv_timer_t *t)
{
    (void)t;
    app_state_t st = g_app_state;
    bool animate = (st == APP_STATE_LISTENING || st == APP_STATE_SPEAKING);
    if (!animate) {
        if (st == APP_STATE_IDLE) {
            /* idle: bars mirror the live microphone level - if they move
             * while you speak, the mics hear you (wake-word diagnostics) */
            s_bar_frame++;
            float level = sqrtf((float)g_mic_rms) * 0.42f;
            if (level > 30.0f) level = 30.0f;
            for (int i = 0; i < 8; i++) {
                int h = 8 + (int)(level * (0.5f + 0.5f * sinf(s_bar_frame * 0.6f + i * 0.9f)));
                lv_obj_set_height(s_bars[i], h);
                lv_obj_set_style_bg_color(s_bars[i], level > 8.0f ? COL_GREEN : COL_DIM, 0);
            }
            return;
        }
        for (int i = 0; i < 8; i++) {
            lv_obj_set_height(s_bars[i], 8);
            lv_obj_set_style_bg_color(s_bars[i], COL_DIM, 0);
        }
        return;
    }
    s_bar_frame++;
    for (int i = 0; i < 8; i++) {
        int h = 8 + (int)(28 * (0.5 + 0.5 * sinf(s_bar_frame * 0.55f + i * 0.9f))
                          * (0.4f + 0.6f * ((i * 7919) % 100) / 99.0f));
        lv_obj_set_height(s_bars[i], h);
        lv_obj_set_style_bg_color(s_bars[i], st == APP_STATE_SPEAKING ? COL_ACCENT : COL_GREEN, 0);
    }
}

void app_ui_set_state(app_state_t st)
{
    if (!lvgl_port_lock(3000)) return;
    lv_obj_set_style_text_color(s_state_label,
                                st == APP_STATE_ERROR ? lv_color_hex(0xEF4444) : COL_TEXT, 0);
    if (s_state_dot) {
        lv_color_t dot_color = COL_DIM;
        if (st == APP_STATE_IDLE) dot_color = COL_GREEN;
        else if (st == APP_STATE_LISTENING) dot_color = COL_GREEN;
        else if (st == APP_STATE_THINKING) dot_color = lv_color_hex(0xF59E0B);
        else if (st == APP_STATE_SPEAKING) dot_color = COL_ACCENT;
        else if (st == APP_STATE_ERROR) dot_color = lv_color_hex(0xEF4444);
        lv_obj_set_style_bg_color(s_state_dot, dot_color, 0);
    }
    lv_label_set_text(s_state_label, state_text(st));
    lvgl_port_unlock();
}

/* screen tap -> interrupt / talk event */
static void screen_clicked_cb(lv_event_t *e)
{
    (void)e;
    app_post_event(APP_EVT_TOUCH, 0);
}

void app_ui_init(void)
{
    s_stream_text = heap_caps_malloc(16384, MALLOC_CAP_SPIRAM);
    if (s_stream_text) s_stream_text[0] = 0;

    /* LVGL task pinned to core 1 (lwIP stays on core 0 via Kconfig), larger
     * stack for the streaming-label updates. Same pattern as the proven
     * smartcar_remote display init on this board. */
    lvgl_port_cfg_t port_cfg = ESP_LVGL_PORT_INIT_CONFIG();
    port_cfg.task_stack = 9216;
    port_cfg.task_affinity = 1;
    bsp_display_cfg_t bsp_cfg = {
        .lvgl_port_cfg = port_cfg,
    };
    lv_display_t *disp = bsp_display_start_with_config(&bsp_cfg);
    int hres = lv_display_get_horizontal_resolution(disp);
    int vres = lv_display_get_vertical_resolution(disp);
    ESP_LOGI(TAG, "display %dx%d", hres, vres);

    lvgl_port_lock(0);
    s_screen = lv_screen_active();
    lv_obj_set_style_bg_color(s_screen, COL_BG, 0);
    lv_obj_add_flag(s_screen, LV_OBJ_FLAG_CLICKABLE);
    lv_obj_add_event_cb(s_screen, screen_clicked_cb, LV_EVENT_CLICKED, NULL);

    /* ---- top bar ---- */
    lv_obj_t *top = lv_obj_create(s_screen);
    lv_obj_set_size(top, LV_PCT(100), UI_TOP_H);
    lv_obj_align(top, LV_ALIGN_TOP_MID, 0, 0);
    lv_obj_set_style_bg_color(top, COL_PANEL, 0);
    lv_obj_set_style_bg_opa(top, LV_OPA_COVER, 0);
    lv_obj_set_style_border_width(top, 0, 0);
    lv_obj_set_style_radius(top, 0, 0);
    lv_obj_set_style_pad_hor(top, 16, 0);
    lv_obj_clear_flag(top, LV_OBJ_FLAG_SCROLLABLE);

    lv_obj_t *title = lv_label_create(top);
    lv_obj_set_style_text_font(title, FONT_CJK, 0);
    lv_obj_set_style_text_color(title, COL_TEXT, 0);
    lv_label_set_text(title, "小鱼 · 智能语音助手");
    lv_obj_align(title, LV_ALIGN_LEFT_MID, 0, 0);

    s_wifi_label = lv_label_create(top);
    lv_obj_set_style_text_font(s_wifi_label, FONT_CJK, 0);
    lv_obj_set_style_text_color(s_wifi_label, COL_DIM, 0);
    lv_label_set_text(s_wifi_label, "WiFi 连接中");
    lv_obj_align(s_wifi_label, LV_ALIGN_RIGHT_MID, 0, 0);

    /* ---- status panel ---- */
    lv_obj_t *panel = lv_obj_create(s_screen);
    lv_obj_set_size(panel, LV_PCT(100), UI_STATUS_H);
    lv_obj_align(panel, LV_ALIGN_TOP_MID, 0, UI_TOP_H);
    lv_obj_set_style_bg_color(panel, COL_PANEL, 0);
    lv_obj_set_style_bg_opa(panel, LV_OPA_COVER, 0);
    lv_obj_set_style_border_width(panel, 0, 0);
    lv_obj_set_style_radius(panel, 0, 0);
    lv_obj_clear_flag(panel, LV_OBJ_FLAG_SCROLLABLE);

    for (int i = 0; i < 8; i++) {
        s_bars[i] = lv_obj_create(panel);
        lv_obj_set_size(s_bars[i], 10, 8);
        /* Use one coordinate system only.  Combining set_x() with
         * TOP_MID alignment offsets the bars twice and clips the last bar. */
        lv_obj_set_pos(s_bars[i], hres / 2 - (8 * 18 - 8) / 2 + i * 18, 10);
        lv_obj_set_style_bg_color(s_bars[i], COL_DIM, 0);
        lv_obj_set_style_bg_opa(s_bars[i], LV_OPA_COVER, 0);
        lv_obj_set_style_border_width(s_bars[i], 0, 0);
        lv_obj_set_style_radius(s_bars[i], 4, 0);
        lv_obj_clear_flag(s_bars[i], LV_OBJ_FLAG_SCROLLABLE);
    }

    s_state_dot = lv_obj_create(panel);
    lv_obj_set_size(s_state_dot, 12, 12);
    lv_obj_align(s_state_dot, LV_ALIGN_TOP_LEFT, 20, 57);
    lv_obj_set_style_bg_color(s_state_dot, COL_DIM, 0);
    lv_obj_set_style_bg_opa(s_state_dot, LV_OPA_COVER, 0);
    lv_obj_set_style_radius(s_state_dot, LV_RADIUS_CIRCLE, 0);
    lv_obj_set_style_border_width(s_state_dot, 0, 0);
    lv_obj_clear_flag(s_state_dot, LV_OBJ_FLAG_SCROLLABLE | LV_OBJ_FLAG_CLICKABLE);

    s_state_label = lv_label_create(panel);
    lv_obj_set_style_text_font(s_state_label, FONT_CJK, 0);
    lv_obj_set_style_text_color(s_state_label, COL_TEXT, 0);
    lv_label_set_text(s_state_label, state_text(APP_STATE_BOOT));
    lv_obj_set_width(s_state_label, 360);
    lv_label_set_long_mode(s_state_label, LV_LABEL_LONG_DOT);
    lv_obj_align(s_state_label, LV_ALIGN_TOP_LEFT, 42, 51);

    lv_obj_t *volume_title = lv_label_create(panel);
    lv_obj_set_style_text_font(volume_title, FONT_CJK, 0);
    lv_obj_set_style_text_color(volume_title, COL_DIM, 0);
    lv_label_set_text(volume_title, "喇叭音量");
    lv_obj_align(volume_title, LV_ALIGN_TOP_LEFT, 20, 96);

    s_volume_slider = lv_slider_create(panel);
    lv_obj_set_size(s_volume_slider, 250, 14);
    lv_obj_align(s_volume_slider, LV_ALIGN_TOP_LEFT, 132, 100);
    lv_slider_set_range(s_volume_slider, 0, 100);
    lv_slider_set_value(s_volume_slider, CONFIG_SMART_VOICE_SPEAKER_VOLUME, LV_ANIM_OFF);
    lv_obj_set_style_bg_color(s_volume_slider, lv_color_hex(0x303944), LV_PART_MAIN);
    lv_obj_set_style_bg_opa(s_volume_slider, LV_OPA_COVER, LV_PART_MAIN);
    lv_obj_set_style_radius(s_volume_slider, 7, LV_PART_MAIN);
    lv_obj_set_style_bg_color(s_volume_slider, COL_ACCENT, LV_PART_INDICATOR);
    lv_obj_set_style_bg_opa(s_volume_slider, LV_OPA_COVER, LV_PART_INDICATOR);
    lv_obj_set_style_radius(s_volume_slider, 7, LV_PART_INDICATOR);
    lv_obj_set_style_bg_color(s_volume_slider, COL_TEXT, LV_PART_KNOB);
    lv_obj_set_style_pad_all(s_volume_slider, 4, LV_PART_KNOB);
    lv_obj_add_event_cb(s_volume_slider, volume_slider_cb, LV_EVENT_VALUE_CHANGED, NULL);

    s_volume_label = lv_label_create(panel);
    lv_obj_set_style_text_font(s_volume_label, FONT_CJK, 0);
    lv_obj_set_style_text_color(s_volume_label, COL_TEXT, 0);
    update_volume_label(CONFIG_SMART_VOICE_SPEAKER_VOLUME);
    lv_obj_align(s_volume_label, LV_ALIGN_TOP_LEFT, 400, 93);

    lv_obj_t *volume_hint = lv_label_create(panel);
    lv_obj_set_style_text_font(volume_hint, FONT_CJK, 0);
    lv_obj_set_style_text_color(volume_hint, COL_DIM, 0);
    lv_label_set_text(volume_hint, "拖动调节");
    lv_obj_align(volume_hint, LV_ALIGN_TOP_LEFT, 470, 96);

    /* ---- chat area ---- */
    s_chat_list = lv_obj_create(s_screen);
    lv_obj_set_size(s_chat_list, LV_PCT(100), vres - UI_TOP_H - UI_STATUS_H - 8);
    lv_obj_align(s_chat_list, LV_ALIGN_BOTTOM_MID, 0, 0);
    lv_obj_set_style_bg_color(s_chat_list, COL_BG, 0);
    lv_obj_set_style_border_width(s_chat_list, 0, 0);
    lv_obj_set_style_pad_all(s_chat_list, 8, 0);
    lv_obj_set_scrollbar_mode(s_chat_list, LV_SCROLLBAR_MODE_AUTO);
    lv_obj_set_flex_flow(s_chat_list, LV_FLEX_FLOW_COLUMN);

    add_bubble("你好,小鱼！我是在线语音助手，说「你好,小鱼」开始对话。", false);

    lvgl_port_unlock();

    s_bar_timer = lv_timer_create(bar_timer_cb, 90, NULL);
}
